## tests/fixtures/zephyr_ws/zephyr/samples/basic/blinky/sample.yaml
```yaml
sample:
  name: Blinky
  description: Blink an LED forever using the GPIO API.
tests:
  sample.basic.blinky:
    tags:
      - LED
      - gpio
    depends_on: gpio
    harness: led
    integration_platforms:
      - frdm_k64f
```

## tests/fixtures/zephyr_ws/zephyr/samples/basic/button/sample.yaml
```yaml
sample:
  name: Button
  description: Handle a button press via GPIO interrupt.
tests:
  sample.basic.button:
    tags: button gpio
    harness: button
    filter: dt_alias_exists("sw0")
```

## tests/fixtures/zephyr_ws/zephyr/samples/drivers/adc/sample.yaml
```yaml
sample:
  name: ADC sequence
  description: Read analog inputs with the ADC driver.
tests:
  sample.drivers.adc:
    tags: adc
    platform_allow:
      - nrf52840dk/nrf52840
    harness: console
```

## tests/fixtures/zephyr_ws/zephyr/tests/kernel/semaphore/testcase.yaml
```yaml
tests:
  kernel.semaphore:
    tags: kernel semaphore
    platform_allow: native_sim
    harness: ztest
```
